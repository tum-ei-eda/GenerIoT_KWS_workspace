## target_sw/app/micro_kws_esp32devboard_perf/sdkconfig.defaults
```kconfig
CONFIG_ESP_TASK_WDT_TIMEOUT_S=60
#
# MLonMCU Options
#
CONFIG_MLONMCU_CODEGEN_DIR=""
CONFIG_MLONMCU_NUM_RUNS=1
# end of MLonMCU Options

#
# TFLite Micro Build Options
#
CONFIG_TF_DIR=""
# end of TFLite Micro Build Options

#
# TVM Build Options
#
CONFIG_TVM_DIR=""
# end of TVM Build Options

#
# FreeRTOS Build Options
#
CONFIG_FREERTOS_GENERATE_RUN_TIME_STATS=y
# end of FreeRTOS Build Options

#
# KWS Options
#
f.write("CONFIG_MICRO_KWS_NUM_CLASSES=10
CONFIG_MICRO_KWS_POSTERIOR_SUPPRESSION_MS=800
CONFIG_MICRO_KWS_POSTERIOR_HISTORY_LENGTH=50
CONFIG_MICRO_KWS_POSTERIOR_TRIGGER_THRESHOLD_SINGLE=180
CONFIG_MICRO_KWS_CLASS_LABEL_0="silence"
CONFIG_MICRO_KWS_CLASS_LABEL_1="unkown"
CONFIG_MICRO_KWS_CLASS_LABEL_2="yes"
CONFIG_MICRO_KWS_CLASS_LABEL_3="no"
CONFIG_MICRO_KWS_CLASS_LABEL_4="up"
CONFIG_MICRO_KWS_CLASS_LABEL_5="down"
CONFIG_MICRO_KWS_CLASS_LABEL_6="left"
CONFIG_MICRO_KWS_CLASS_LABEL_7="right"
CONFIG_MICRO_KWS_CLASS_LABEL_8="on"
CONFIG_MICRO_KWS_CLASS_LABEL_9="off"
#

# Disable watchdogs?
CONFIG_INT_WDT=
CONFIG_TASK_WDT=
```
